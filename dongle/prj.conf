## CMakeLists.txt
```
cmake_minimum_required(VERSION 3.20.0)
find_package(Zephyr REQUIRED HINTS $ENV{ZEPHYR_BASE})
project(dongle)

# PLAN.md §4's binding decision, 2026-08-12: identity is baked into the image
# at build time, generated per unit by dongle/tools/provision.py, rather than
# read from a flash partition written by a separate step. There is no default
# to silently fall back to — a build with no real identity is a build error,
# not a boot-time state (engine.c's own validate() call is the belt-and-
# braces second check, for a header that exists but is wrong, not absent).
if(NOT CONFIG_PROVISIONING_HEADER_DIR)
  message(FATAL_ERROR
    "CONFIG_PROVISIONING_HEADER_DIR not set. Generate one with dongle/tools/"
    "provision.py and pass -DCONFIG_PROVISIONING_HEADER_DIR=<dir containing "
    "provisioning_data.h>. See dongle/BUILD_SPEC.md §9.")
endif()
if(NOT EXISTS "${CONFIG_PROVISIONING_HEADER_DIR}/provisioning_data.h")
  message(FATAL_ERROR "No provisioning_data.h in ${CONFIG_PROVISIONING_HEADER_DIR}")
endif()
target_include_directories(app PRIVATE ${CONFIG_PROVISIONING_HEADER_DIR})

target_sources(app PRIVATE
  src/main.c
  src/protocol.c
  src/usb_link.c
  src/engine.c
  src/indicator.c
  ../common/provisioning.c
)

# Stage 2 (BUILD_SPEC.md §9): the record's shape lives in ../common, shared
# unchanged with the remote firmware, so it is not duplicated under src/.
target_include_directories(app PRIVATE ${CMAKE_CURRENT_SOURCE_DIR}/../common)

# Stage 3: ../common/rframe.h reuses protocol.h's button/gesture/remote/
# waveform/indicator enums as its own vocabulary (radio.h has done this since
# Stage 1 — "the engine never acquires a second name for something the wire
# protocol already names"), so a common/ header needs src/ on its include
# path to reach a src/ header. protocol.c itself is never linked into the
# remote firmware; only the enum declarations are needed there.
target_include_directories(app PRIVATE ${CMAKE_CURRENT_SOURCE_DIR}/src)

# Exactly one implementation of radio.h is compiled in.
#
# rframe.c is scoped to the y branch, not the unconditional list above:
# radio_null.c never touches a frame (BUILD_SPEC §2 — "everything DISCONNECTED,
# rendered on the board's two LEDs"), so linking the codec into the no-radio
# baseline would be dead weight with no caller.
if(CONFIG_DONGLE_RADIO)
  target_sources(app PRIVATE src/radio_ble.c ../common/rframe.c)
else()
  target_sources(app PRIVATE src/radio_null.c)
endif()
```

## Kconfig
```
menu "Dongle bridge options"

config PROVISIONING_HEADER_DIR
	string "Directory containing this unit's generated provisioning_data.h"
	help
	  Generated by dongle/tools/provision.py — PLAN.md §4's binding
	  decision, 2026-08-12: identity is baked into the image at build
	  time, not read from a flash partition written by a separate step.

	  A plain CMake -D variable would not do here: west build runs under
	  sysbuild, which only forwards CONFIG_-prefixed values into a
	  specific image's cache automatically, the same reason
	  CONFIG_DONGLE_RADIO above works with a bare -D and an arbitrary
	  CMake variable would not.

	  No default. CMakeLists.txt FATAL_ERRORs at configure time if this
	  is empty or the file isn't there — there is no such thing as a
	  build that silently carries no identity.

config DONGLE_RADIO
	bool "Bluetooth LE radio to the wrist remotes"
	default n
	select BT
	select BT_CENTRAL
	select BT_GATT_CLIENT
	select BT_SMP
	select BT_NRF_CONN_SET_LTK
	select BT_USER_PHY_UPDATE
	help
	  Selects src/radio_ble.c, the BLE central that talks
	  RADIO_PROTOCOL.md v1.0 to two wrist remotes.

	  n selects src/radio_null.c: both remotes report DISCONNECTED,
	  the downlink is rendered on the board's two LEDs, and the whole
	  wire layer runs unchanged, driven by the TEST modes.

	  THE n CONFIGURATION IS RETAINED PERMANENTLY. It is not scaffolding
	  and it is not a milestone that was green once. PLAN.md §5.4 lists
	  eight ways adding a radio degrades a working USB link without
	  touching any USB code, and every one of them is diagnosed by asking
	  whether it still happens with the radio compiled out. A baseline
	  you can re-run in thirty seconds answers that.

	  This defaults to n only because radio_ble.c does not exist yet; it
	  flips to y at Stage 3 (PLAN.md §2.1, the work queue) when it does.

	  It REPLACES the deleted DONGLE_FAKE_LINK, which reported both
	  remotes CONNECTED with a fixed RSSI and battery. That symbol was
	  deleted rather than defaulted off: it fabricated exactly the values
	  a link test measures, and it did so plausibly, so a forgotten y
	  produced a passing test. A default is no protection when the
	  failure mode is forgetting.

config DONGLE_CONN_INTERVAL_UNITS
	int "BLE connection interval, in 1.25 ms units"
	depends on DONGLE_RADIO
	default 6
	range 6 3200
	help
	  6 units = 7.5 ms, rung 3 of RADIO_PROTOCOL.md §12.2 and the
	  baseline for the whole programme. It is a Kconfig value rather
	  than a header constant because it is the one tuning number with a
	  hardware consequence behind it: it feeds the power budget, and
	  through that the battery sizing and the PCB.

	  A later descent to 2.5 ms (SCI, rung 1) triples connection events
	  per second, so an undersized battery would become a respin. Size
	  with headroom. SCI is a deferred contingency, revisited only if
	  body shadowing proves a problem on custom hardware.

	  Both connections must use the identical interval — central
	  scheduling needs a common factor between them or their events
	  collide.

endmenu

source "Kconfig.zephyr"
```

## prj.conf
```kconfig
# ---------------------------------------------------------------------------
# USB CDC-ACM, on the new (device_next) stack.
#
# The board's Kconfig.defconfig already defaults these on via
# boards/common/usb/Kconfig.cdc_acm_serial.defconfig. They are stated
# explicitly so the intent survives an SDK or board bump.
#
# INITIALIZE_AT_BOOT brings up the USB device stack and the single CDC-ACM
# instance before main() runs. It depends only on USBD_CDC_ACM_CLASS, not on
# CONSOLE, so it still works with the console detached below.
# ---------------------------------------------------------------------------
CONFIG_USB_DEVICE_STACK_NEXT=y
CONFIG_USBD_CDC_ACM_CLASS=y
CONFIG_CDC_ACM_SERIAL_INITIALIZE_AT_BOOT=y
CONFIG_SERIAL=y
CONFIG_UART_INTERRUPT_DRIVEN=y

# ---------------------------------------------------------------------------
# The protocol owns the CDC-ACM port exclusively. See PLAN.md §1.4.
#
# The board's common devicetree points zephyr,console AND zephyr,shell-uart
# AND zephyr,uart-mcumgr AND both bt-*-uart chosen nodes at the one CDC-ACM
# instance. If any of them stays live it interleaves bytes into the protocol
# stream: a log line over 120 bytes trips the receiver's discard-and-resync
# path, and a write landing mid-line corrupts that line. Both failures are
# silent and intermittent.
#
# Diagnostics leave the dongle as protocol `LOG`/`ERR` lines instead (§3),
# which the app already renders in its debug panel.
# ---------------------------------------------------------------------------
CONFIG_CONSOLE=n
CONFIG_UART_CONSOLE=n
CONFIG_LOG=n
CONFIG_SHELL=n
CONFIG_BOOT_BANNER=n

# ---------------------------------------------------------------------------
# Application
# ---------------------------------------------------------------------------
CONFIG_RING_BUFFER=y
CONFIG_GPIO=y
CONFIG_MAIN_STACK_SIZE=2048
CONFIG_SYSTEM_WORKQUEUE_STACK_SIZE=2048

# ---------------------------------------------------------------------------
# BLE (Stage 3, BUILD_SPEC.md §7/§10). Only take effect when
# CONFIG_DONGLE_RADIO=y selects CONFIG_BT (Kconfig); harmless, unused lines
# under the CONFIG_DONGLE_RADIO=n baseline.
#
# No settings backend: RP §10.3 stores nothing to erase, migrate or corrupt —
# the LTK comes from PROV_RECORD.set_key (provisioning_data.h, baked in at
# build time — PLAN.md §4, 2026-08-12) every boot via bt_nrf_conn_set_ltk(),
# never through Zephyr's bonding/settings path. CONFIG_BT_BONDABLE=n is the
# compiled-in half of that; radio_ble.c's runtime bt_set_bondable(false) is
# the other, belt and braces, same reasoning as the GATT ENCRYPT permissions
# being a second lock on a door the LTK already bolts (RP §3.1).
# ---------------------------------------------------------------------------
CONFIG_BT_MAX_CONN=2
CONFIG_BT_MAX_PAIRED=2
CONFIG_BT_BONDABLE=n
CONFIG_BT_PRIVACY=n
CONFIG_BT_SETTINGS=n
CONFIG_BT_DEVICE_NAME="RefRemote Dongle"
```

## src/main.c
```c
/*
 * USB bridge dongle: relays referee presses from the wrist remotes to the
 * scoreboard web app over USB CDC-ACM, and routes the app's acknowledgements,
 * indicator state and haptic commands back to the wrists.
 *
 * PROTOCOL.md is the wire contract, RADIO_PROTOCOL.md the radio one, and
 * BUILD_SPEC.md the implementable contract for this firmware. PLAN.md says what
 * state the project is in and why the work is ordered as it is.
 *
 * With CONFIG_DONGLE_RADIO=n the radio is compiled out entirely and the TEST
 * modes of §10.2 stand in for real remotes. That configuration is retained for
 * the life of the project — it is the baseline every later radio regression is
 * attributed against, not scaffolding.
 */
#include "engine.h"
#include "indicator.h"
#include "usb_link.h"

#include <zephyr/kernel.h>

int main(void)
{
	if (indicator_init() != 0) {
		return 0;
	}

	/*
	 * The order below is a dependency cycle broken in the only place it
	 * can be. The transport needs the engine's workqueue before it can
	 * accept a byte; the engine needs the transport before it can say
	 * anything. So the engine builds its queue and state first, the
	 * transport is handed that queue, and only then does the engine start
	 * talking.
	 *
	 * USB itself is already up: CONFIG_CDC_ACM_SERIAL_INITIALIZE_AT_BOOT
	 * brings up the device stack and the single CDC-ACM instance before
	 * main() runs. All we do here is claim the UART side of it.
	 */
	engine_init();

	if (usb_link_init(engine_on_line, engine_workq()) != 0) {
		/* Nowhere to report this — the port is the only output we have,
		 * and it is what just failed. Blink and stop. */
		indicator_error();
		return 0;
	}

	/*
	 * This one call runs on the main thread rather than the engine queue,
	 * so for the few microseconds it takes there are technically two
	 * producers. It is left as is: the transmit ring is mutex-protected
	 * either way, and the only way a line could arrive in that window is if
	 * the host had already enumerated the port and an operator had already
	 * opened it — which cannot happen before main() returns.
	 */
	engine_start();

	/* Everything from here runs on the engine workqueue. */
	return 0;
}
```

## src/engine.h
```c
/*
 * Protocol state machine: link supervision (§8), acknowledgement routing (§5.3,
 * §11), indicator and haptic relay (§6, §9), and the TEST modes (§10.2).
 *
 * It holds no match state — not the clock, not the score, not secondary-clock
 * ownership. Everything it holds is transport state. v2.0's dongle-local clock
 * and 1 Hz heartbeat are deleted, not ported: FS §6.2 forbids a node beating on
 * locally-held ownership state, because it can report one athlete on the wrist
 * while the scoreboard reports another, silently and with nothing to correct it.
 *
 * Everything here runs on ONE cooperative workqueue, owned by this module, so
 * there is exactly one producer feeding the transmit path and no locking is
 * needed between the timers, the receive path and the test drivers. The USB
 * receive path and (later) the Bluetooth callbacks both marshal onto it rather
 * than calling in from their own threads — that is what keeps the invariant
 * true once a second source of events exists.
 *
 * Cooperative rather than preemptible for one reason: a preemptible queue can
 * be descheduled between receiving an ACK and handing the tap to the radio, and
 * that latency is invisible. It shows up as a missing tap under load and as
 * nothing else at all.
 */
#ifndef DONGLE_ENGINE_H_
#define DONGLE_ENGINE_H_

struct k_work_q;

/*
 * Initialisation is split in two because the transport needs the workqueue
 * before it can accept a byte, and the engine needs the transport before it can
 * say anything. main() interleaves them:
 *
 *   engine_init();                                  state and queue, no I/O
 *   usb_link_init(engine_on_line, engine_workq());
 *   engine_start();                                 boot HELLO, timers, radio
 */
void engine_init(void);
struct k_work_q *engine_workq(void);
void engine_start(void);

/* Called by the transport with one complete received line, on the engine
 * workqueue. The buffer is reused after this returns. */
void engine_on_line(char *line);

#endif /* DONGLE_ENGINE_H_ */
```

## src/indicator.c
```c
#include "indicator.h"

#include <zephyr/kernel.h>
#include <zephyr/drivers/gpio.h>

/* Board aliases: led0 = D1 = P0.06, led1 = D2 = P0.08. The "-green"/"-red"
 * alias spellings this board also carries are inherited from the Nordic dongle
 * and describe nothing here — both parts are blue, and only ONE is fitted.
 * Measured 2026-08-11: the fitted lamp is on P0.06, i.e. the GREEN channel,
 * which is the opposite of what Raytac's pin table says (BOARD.md §2).
 *
 * The GREEN/RED naming below is the REMOTE's identity, not a colour. Both nodes
 * are GPIO_ACTIVE_LOW, which gpio_pin_set_dt() handles for us — 1 means "lit". */
static const struct gpio_dt_spec led_green = GPIO_DT_SPEC_GET(DT_ALIAS(led0), gpios);
static const struct gpio_dt_spec led_red = GPIO_DT_SPEC_GET(DT_ALIAS(led1), gpios);

/*
 * Pattern steps alternate on/off durations in milliseconds, starting with on,
 * and the LED returns to its base level when the sequence runs out.
 *
 * The durations are chosen to be *distinguishable on a bench*, which is a
 * different requirement from the wrist waveforms they stand for — see the
 * header. BEAT being merely shorter than TAP is the clearest case: on the
 * wrist the distinction is amplitude, and it is load-bearing for repeated-press
 * scoring (§9.1). Nothing observed here validates it.
 */
static const uint16_t pat_tap[]    = { 40 };
static const uint16_t pat_beat[]   = { 12 };
static const uint16_t pat_warn[]   = { 200 };
static const uint16_t pat_buzz[]   = { 120 };
static const uint16_t pat_long[]   = { 500 };
static const uint16_t pat_double[] = { 60, 70, 60 };
static const uint16_t pat_triple[] = { 60, 70, 60, 70, 60 };
static const uint16_t pat_error[]  = { 150 };

struct waveform_pattern {
	const uint16_t *steps;
	size_t count;
};

#define PATTERN(p) { (p), ARRAY_SIZE(p) }

static const struct waveform_pattern waveforms[PROTO_WF_COUNT] = {
	[PROTO_WF_TAP]    = PATTERN(pat_tap),
	[PROTO_WF_BEAT]   = PATTERN(pat_beat),
	[PROTO_WF_WARN]   = PATTERN(pat_warn),
	[PROTO_WF_BUZZ]   = PATTERN(pat_buzz),
	[PROTO_WF_LONG]   = PATTERN(pat_long),
	[PROTO_WF_DOUBLE] = PATTERN(pat_double),
	[PROTO_WF_TRIPLE] = PATTERN(pat_triple),
};

struct blinker {
	const struct gpio_dt_spec *led;
	struct k_work_delayable work;
	const uint16_t *steps;
	size_t count;
	size_t idx;
	bool base;
};

static struct blinker leds[PROTO_REMOTE_COUNT];

/* Not a remote's LED: fault indication borrows RED, because a fault is not
 * attributable to one wrist and the alternative is a third LED this board does
 * not have.
 *
 * On this board RED is the UNFITTED channel (P0.08), so every fault indication
 * is invisible. That is kept on purpose. Moving it to the fitted lamp would put
 * errors on the same channel as every GREEN haptic, and the ability to tell
 * those apart is what proved per-remote routing at all (BOARD.md §2.1). Faults
 * already leave on the wire as ERR lines, which is a richer channel than a
 * blink; haptics have nothing else. So the one lamp goes to haptics. */
static struct blinker *const fault_led = &leds[PROTO_REMOTE_RED];

static void blinker_step(struct k_work *work)
{
	struct k_work_delayable *dwork = k_work_delayable_from_work(work);
	struct blinker *b = CONTAINER_OF(dwork, struct blinker, work);

	if (b->idx >= b->count) {
		/* Restore the steady level rather than switching off: a haptic
		 * command must not clear indicator state the app asserted. */
		(void)gpio_pin_set_dt(b->led, b->base ? 1 : 0);
		return;
	}

	(void)gpio_pin_set_dt(b->led, (b->idx % 2u == 0u) ? 1 : 0);
	k_work_reschedule(&b->work, K_MSEC(b->steps[b->idx]));
	b->idx++;
}

/* Last pattern wins — a new request restarts the sequence rather than queueing.
 * Queueing would render a burst of taps as a longer buzz, which is the opposite
 * of what a referee counting acknowledgements needs. */
static void blinker_start(struct blinker *b, const struct waveform_pattern *p)
{
	if (p->steps == NULL || p->count == 0) {
		return;
	}
	b->steps = p->steps;
	b->count = p->count;
	b->idx = 0;
	k_work_reschedule(&b->work, K_NO_WAIT);
}

static int blinker_init(struct blinker *b, const struct gpio_dt_spec *led)
{
	int err;

	if (!gpio_is_ready_dt(led)) {
		return -ENODEV;
	}
	err = gpio_pin_configure_dt(led, GPIO_OUTPUT_INACTIVE);
	if (err != 0) {
		return err;
	}

	b->led = led;
	b->base = false;
	k_work_init_delayable(&b->work, blinker_step);
	return 0;
}

int indicator_init(void)
{
	int err = blinker_init(&leds[PROTO_REMOTE_RED], &led_red);

	if (err != 0) {
		return err;
	}
	return blinker_init(&leds[PROTO_REMOTE_GREEN], &led_green);
}

void indicator_base(enum proto_remote r, bool lit)
{
	struct blinker *b;

	if (r >= PROTO_REMOTE_COUNT) {
		return;
	}
	b = &leds[r];
	b->base = lit;

	/* Only take the LED now if no pattern is running; otherwise the pattern
	 * will land on the new base when it finishes. */
	if (b->idx >= b->count) {
		(void)gpio_pin_set_dt(b->led, lit ? 1 : 0);
	}
}

void indicator_haptic(enum proto_remote r, enum proto_waveform w)
{
	if (r >= PROTO_REMOTE_COUNT || w >= PROTO_WF_COUNT) {
		return;
	}
	blinker_start(&leds[r], &waveforms[w]);
}

void indicator_error(void)
{
	static const struct waveform_pattern err_pattern = PATTERN(pat_error);

	blinker_start(fault_led, &err_pattern);
}
```

## src/indicator.h
```c
/*
 * Bench stand-in for the remote haptics and indicators, on the dongle's own
 * indicator LED.
 *
 * ONE BLUE LAMP, ON THE GREEN CHANNEL. The devicetree presents two nodes,
 * led0 (P0.06) and led1 (P0.08), aliased led0-green and led1-red. Those alias
 * names are copied from the NORDIC nRF52840 Dongle, which has a real RGB part;
 * this board has two blue parts and only one of them is fitted. MEASURED
 * 2026-08-11: the fitted one is on P0.06 — the GREEN channel — which is the
 * opposite of Raytac's own pin table. BOARD.md §2 carries the evidence, and
 * exists because this fact was derived from the alias names twice and got wrong
 * both times.
 *
 * One channel per remote — led0/P0.06 is GREEN, led1/P0.08 is RED — with two
 * layers on each: a steady *base* level asserted by STATE, and a transient
 * *haptic* pattern that plays over it and restores the base afterwards.
 *
 * WHAT THIS CANNOT SHOW, stated here because a stand-in that looks complete is
 * worse than one that obviously is not:
 *
 *  - ANYTHING ADDRESSED TO RED. That channel drives the empty footprint, so
 *    HAP RED, STATE RED and indicator_error() are all silent. Note the
 *    consequence for debugging: on this board "no blink" NEVER means "no
 *    error" — errors leave on the wire as ERR lines and nowhere else.
 *  - Colour, as STATE means it. STATE carries an RGB triple per indicator;
 *    what is here is one bit per remote, and it is blue whatever was asked for.
 *
 * What it CAN show, unexpectedly, is per-remote routing — precisely BECAUSE one
 * lamp is missing. A firmware ignoring the target would light P0.06 for HAP RED
 * as well as for HAP GREEN; one blinks and one does not. Confirmed 2026-08-11.
 *  - Which of F1 and F2 is lit. The base is the disjunction of the two.
 *  - The one amplitude that is a requirement. PROTOCOL.md §9.1 makes BEAT
 *    "unmistakably weaker than TAP on the wrist, through a strap, in motion" —
 *    an amplitude difference. A GPIO LED has no amplitude, so BEAT is rendered
 *    as a shorter flash, which is a different distinction wearing the same
 *    name. Whether one ERM can deliver the real separation is an open item
 *    (PLAN.md R3/R4) and nothing observed here speaks to it.
 *
 * This is the routing and timing of the haptic path made visible, and no more
 * than that.
 */
#ifndef DONGLE_INDICATOR_H_
#define DONGLE_INDICATOR_H_

#include "protocol.h"

#include <stdbool.h>

int indicator_init(void);

/* Steady level for one remote, from STATE. Survives haptic patterns. */
void indicator_base(enum proto_remote r, bool lit);

/* Transient pattern for one remote, from a downlink haptic command. */
void indicator_haptic(enum proto_remote r, enum proto_waveform w);

/* Fault indication, not tied to a remote. Accompanies every ERR line. */
void indicator_error(void);

#endif /* DONGLE_INDICATOR_H_ */
```

## src/protocol.h
```c
/*
 * PROTOCOL.md v3.0 — the dongle ↔ scoreboard wire contract.
 *
 * NO ZEPHYR DEPENDENCIES. Nothing from zephyr/, no k_* call, no CONFIG_*, no
 * devicetree, no BUILD_ASSERT. Permitted: <stdint.h>, <stddef.h>, <stdbool.h>,
 * <string.h>, <stdio.h>.
 *
 * That rule is what lets tests/protocol/ build and run on a host machine with
 * nothing but gcc — no board, no SDK, no flash cycle. It is worth more than it
 * costs: the parser is the one part of the firmware where a mistake is silent
 * on both ends, and it is the one part that can be exhaustively tested in a
 * second. See dongle/BUILD_SPEC.md §2.1.
 *
 * Framing (§2) is unchanged from v2.0 and must stay that way. Everything above
 * it changed: buttons and gestures replace officiating actions, the dongle-side
 * clock is gone, and CONFIRM became ACK with a 120 ms window.
 */
#ifndef DONGLE_PROTOCOL_H_
#define DONGLE_PROTOCOL_H_

#include <stdbool.h>
#include <stddef.h>
#include <stdint.h>

#define PROTO_VERSION       "4.0"

/* §2.1: 120 bytes including the terminator. */
#define PROTO_MAX_LINE      120u
#define PROTO_MAX_CONTENT   (PROTO_MAX_LINE - 1u)

/* Slack over PROTO_MAX_LINE so an overlong run is detected inside the buffer
 * rather than at its edge. */
#define PROTO_ASM_BUF_SIZE  128u

/* §5.3: seq is 0-65535, wrapping. Widened from v2.0's 0-999 because hold-repeat
 * at 150 ms wraps a 1000-entry space in about 2.5 minutes — close enough to a
 * match that a delayed duplicate and a genuine new event could collide on the
 * same number. */
#define PROTO_SEQ_MAX       65535u

/* The longest message takes 5 arguments (STATE). One spare catches an over-long
 * line without the tokenizer having to grow; split_tokens() returns the true
 * count regardless, which is what makes exact-count checks safe. */
#define PROTO_MAX_TOKENS    8u

/* §4.1: [A-Z0-9-]{1,16} */
#define PROTO_SET_SERIAL_MAX 16u

enum proto_remote {
	PROTO_REMOTE_RED = 0,
	PROTO_REMOTE_GREEN,
	PROTO_REMOTE_COUNT
};

/*
 * §5.1 — the seven buttons, named by *position*, not by function.
 *
 * The order here is the order TEST 1 and TEST 4 sweep in, so it is observable
 * on the wire and worth keeping aligned with the table in §5.1 and with the
 * app's BUTTONS array.
 *
 * F1 and F2 are deliberately unnamed: their meaning is a riding-time clock, an
 * advantage counter, a caution counter or a pending-choice flag depending on a
 * ruleset the dongle has never heard of. v2.0's TIME_UP / TIME_DOWN /
 * PERIOD_UP / PERIOD_DOWN encoded officiating meaning on the wire and are gone.
 */
enum proto_button {
	PROTO_BTN_ADD_POINT = 0,
	PROTO_BTN_TOGGLE_CLOCK,
	PROTO_BTN_REMOVE_POINT,
	PROTO_BTN_FORWARD,
	PROTO_BTN_BACKWARD,
	PROTO_BTN_F1,
	PROTO_BTN_F2,
	PROTO_BTN_COUNT
};

/*
 * §5.1 — classified in remote firmware, never negotiated over a link.
 *
 * HOLD_REP is emitted only for FORWARD and BACKWARD. That is a rule for the
 * *transmitter*, so it is enforced where events are generated (engine.c's TEST
 * modes, and the remote firmware) rather than in the parser: a receiver that
 * refused the combination would be rejecting a line it is supposed to be able
 * to read back.
 */
enum proto_gesture {
	PROTO_GEST_PRESS = 0,
	PROTO_GEST_HOLD,
	PROTO_GEST_HOLD_REP,
	PROTO_GEST_COUNT
};

/*
 * §6.4, §9 — CFG and HAP address one remote or both.
 *
 * A separate enum from proto_remote because BOTH is not a remote and there is
 * nowhere to put it in a two-entry list. RED and GREEN share the numbering so
 * expanding BOTH is a loop over proto_remote, not a translation table.
 */
enum proto_target {
	PROTO_TGT_RED = 0,
	PROTO_TGT_GREEN,
	PROTO_TGT_BOTH,
	PROTO_TGT_COUNT
};

/* §9. BEAT must be unmistakably weaker than TAP on the wrist (§9.1); that is a
 * property of the remote's waveform tables, not of this enum. */
enum proto_waveform {
	PROTO_WF_TAP = 0,
	PROTO_WF_BEAT,
	PROTO_WF_WARN,
	PROTO_WF_BUZZ,
	PROTO_WF_LONG,
	PROTO_WF_DOUBLE,
	PROTO_WF_TRIPLE,
	PROTO_WF_COUNT
};

/* §6.2. OFF and SOLID only — there is exactly one blinking indicator in the
 * system and it is remote-local, so no blink mode exists here to be misused. */
enum proto_ind_mode {
	PROTO_IND_OFF = 0,
	PROTO_IND_SOLID,
	PROTO_IND_MODE_COUNT
};

/*
 * §6.2. A fixed four-colour palette, not an RGB triple — the app tells the
 * remote which of these to show, never an exact value. LED_F1/LED_F2 (this
 * frame) and LED_LINK/LED_PWR (remote-local, RADIO_PROTOCOL.md §7.2/§7.4)
 * render every one of these identically off the same table
 * (common/ind_colour.c), so a referee learns one "yellow" for the whole
 * wrist rather than a colour per indicator that happens to have the same
 * name. Arbitrary hex on the wire was the mistake this replaces: the app's
 * own brand colours were never calibrated against this hardware, and it
 * showed as a green-tinted "red" and a teal-tinted "green" on LED_F1/LED_F2
 * while LED_LINK/LED_PWR, driven from the same firmware palette, read true.
 */
enum proto_ind_colour {
	PROTO_COLOUR_RED = 0,
	PROTO_COLOUR_GREEN,
	PROTO_COLOUR_BLUE,
	PROTO_COLOUR_YELLOW,
	PROTO_COLOUR_COUNT
};

enum proto_link_state {
	PROTO_LINK_CONNECTED = 0,
	PROTO_LINK_CONNECTING,
	PROTO_LINK_DISCONNECTED,
	PROTO_LINK_STATE_COUNT
};

/*
 * PROTOCOL.md's Factory Commands appendix -- bench-only, never sent by the
 * officiating app, and deliberately not part of the main versioned wire
 * table above. See PROTOCOL.md §16 for the full reasoning: this exists so
 * a bench technician's tool can drive a remote's DRV2605L calibration/OTP
 * sequence (RADIO_PROTOCOL.md's matching addendum) over the same USB-
 * serial port everything else uses, without a second BLE service on the
 * remote. Mirrors enum rframe_factory_state (common/rframe.h) one-for-one;
 * kept as a separate enum rather than reusing that one because protocol.h
 * must not depend on common/rframe.h (rframe.h depends on protocol.h, not
 * the other way — see rframe.h's own header comment).
 */
enum proto_factory_state {
	PROTO_FACTORY_CAL_DONE = 0,
	PROTO_FACTORY_CAL_FAILED,
	PROTO_FACTORY_OTP_DONE,
	PROTO_FACTORY_OTP_FAILED,
	PROTO_FACTORY_STATE_COUNT
};

enum proto_type {
	PROTO_UNKNOWN = 0,   /* unrecognised keyword — ignore silently (§2.2) */
	PROTO_INVALID,       /* recognised keyword, unusable arguments        */

	/* App -> Dongle */
	PROTO_ACK,
	PROTO_STATE,
	PROTO_HAP,
	PROTO_CFG,
	PROTO_SIMSOC,
	PROTO_PING,
	PROTO_INFO,
	PROTO_ECHO,
	PROTO_TEST,

	/* §16, bench-only. See enum proto_factory_state's comment. */
	PROTO_FACAL,
	PROTO_FACOTP,

	/* Dongle -> App. Parsed only so encoders can be round-tripped in the
	 * host suite; the firmware never receives these. */
	PROTO_HELLO,
	PROTO_EVT,
	PROTO_LINK,
	PROTO_JOIN,
	PROTO_PONG,
	PROTO_LOG,
	PROTO_ERR,
	PROTO_FACSTATUS
};

/*
 * A parsed line. All `const char *` members point into the caller's line
 * buffer, which proto_parse() has written NULs into — they are valid only until
 * that buffer is reused.
 */
struct proto_msg {
	enum proto_type type;
	const char *invalid_reason;   /* set only when type == PROTO_INVALID */

	union {
		struct {
			uint16_t seq;
			bool silent;  /* §5.2: inert button — nothing on the air */
		} ack;

		struct {
			enum proto_remote remote;
			enum proto_ind_mode f1_mode;
			enum proto_ind_colour f1_colour;
			enum proto_ind_mode f2_mode;
			enum proto_ind_colour f2_colour;
		} state;

		struct {
			enum proto_target target;
			enum proto_waveform waveform;
		} hap;

		struct {
			enum proto_target target;
			uint8_t haptic;   /* 0-100 */
			uint8_t bright;   /* 0-100 */
		} cfg;

		/* SIMSOC <target> <pct> — PROTOCOL.md §6.5. Bench-only. */
		struct {
			enum proto_target target;
			uint8_t pct;      /* 0-100 */
		} simsoc;

		struct { uint32_t mode; } test;

		/* ECHO / LOG / ERR: the remainder of the line, verbatim. */
		struct { const char *text; } text;

		struct {
			enum proto_button button;
			enum proto_gesture gesture;
			enum proto_remote src;
			uint16_t seq;
		} evt;

		struct {
			enum proto_remote remote;
			enum proto_link_state state;
			int32_t rssi;
			int32_t batt;
			bool has_rssi;
			bool has_batt;
		} link;

		struct { enum proto_remote remote; } join;

		struct {
			const char *proto;
			const char *fw;
			const char *set;
			uint32_t caps;
		} hello;

		/* FACAL <remote> / FACOTP <remote> — §16, bench-only. */
		struct { enum proto_remote remote; } factory_cmd;

		/* FACSTATUS <remote> <state> <detail> <diag> <vdd_mv> <comp> <bemf> <fb>
		 * — §16, bench-only. */
		struct {
			enum proto_remote remote;
			enum proto_factory_state state;
			uint8_t detail;
			bool diag_pass;
			uint16_t vdd_mv;
			uint8_t a_cal_comp;
			uint8_t a_cal_bemf;
			uint8_t feedback_control;
		} facstatus;
	};
};

/* ------------------------------------------------------------------------ */
/* Line assembler (§2.2)                                                     */
/* ------------------------------------------------------------------------ */

/*
 * `discarding` is the whole point of this being a struct rather than a local.
 * Resynchronisation happens at the next \n, which may be several reads away, so
 * the discard state has to survive a chunk boundary — a split between reads is
 * an artifact of the transport and carries no information about the stream.
 * Test T9c pins this.
 */
struct proto_asm {
	char buf[PROTO_ASM_BUF_SIZE];
	size_t len;
	bool discarding;
};

/* Receives one complete, NUL-terminated line. The buffer is reused after the
 * callback returns. */
typedef void (*proto_line_fn)(char *line, void *user);

void proto_asm_init(struct proto_asm *a);
void proto_asm_feed(struct proto_asm *a, const uint8_t *data, size_t len,
		    proto_line_fn cb, void *user);

/* ------------------------------------------------------------------------ */
/* Parsing                                                                   */
/* ------------------------------------------------------------------------ */

/* Writes NULs into `line` in place. */
void proto_parse(char *line, struct proto_msg *out);

const char *proto_button_name(enum proto_button b);
const char *proto_gesture_name(enum proto_gesture g);
const char *proto_remote_name(enum proto_remote r);
const char *proto_target_name(enum proto_target t);
const char *proto_waveform_name(enum proto_waveform w);
const char *proto_ind_mode_name(enum proto_ind_mode m);
const char *proto_ind_colour_name(enum proto_ind_colour c);
const char *proto_link_state_name(enum proto_link_state s);
const char *proto_factory_state_name(enum proto_factory_state s);

/* ------------------------------------------------------------------------ */
/* Encoding                                                                  */
/* ------------------------------------------------------------------------ */

/* All return the byte count written (excluding the terminator, which the
 * transport appends), or -1 if the line would exceed PROTO_MAX_CONTENT.
 * Refused, never truncated: a truncated line corrupts the receiver's framing. */

int proto_enc_hello(char *out, size_t cap, const char *fw, const char *set,
		    uint32_t caps);
int proto_enc_evt(char *out, size_t cap, enum proto_button b,
		  enum proto_gesture g, enum proto_remote src, uint16_t seq);
int proto_enc_link(char *out, size_t cap, enum proto_remote r,
		   enum proto_link_state st, int32_t rssi,
		   int32_t batt, bool has_batt);
int proto_enc_join(char *out, size_t cap, enum proto_remote r);
int proto_enc_pong(char *out, size_t cap);
int proto_enc_echo(char *out, size_t cap, const char *text);
int proto_enc_log(char *out, size_t cap, const char *text);
int proto_enc_err(char *out, size_t cap, const char *text);
int proto_enc_facstatus(char *out, size_t cap, enum proto_remote r,
			enum proto_factory_state state, uint8_t detail, bool diag_pass,
			uint16_t vdd_mv, uint8_t a_cal_comp, uint8_t a_cal_bemf,
			uint8_t feedback_control);

/* Post-increment wrap. Natural uint16_t overflow — 65535 -> 0 — which is why
 * there is no modulo here any more. The app handles the discontinuity with a
 * wrap heuristic, so seq is never reset on reconnect. */
uint16_t proto_next_seq(uint16_t seq);

#endif /* DONGLE_PROTOCOL_H_ */
```

## src/provisioning_flash.c
```c
#include "provisioning_flash.h"

#include <zephyr/storage/flash_map.h>

#include <string.h>

enum provisioning_status provisioning_load(struct provisioning_record *out)
{
	const struct flash_area *fa;
	uint8_t raw[PROVISIONING_RECORD_SIZE];
	enum provisioning_status status;
	int rc;

	/* storage_partition is the board's own fstab-stock.dtsi node — not an
	 * overlay this project owns — 16 KB at 0xf0000, dongle/BUILD_SPEC.md
	 * §9. Failing to open it reads the same as a blank one to every
	 * caller: both mean "nothing usable is here". */
	rc = flash_area_open(FIXED_PARTITION_ID(storage_partition), &fa);
	if (rc != 0) {
		return PROVISIONING_ERR_MAGIC;
	}

	rc = flash_area_read(fa, 0, raw, sizeof(raw));
	flash_area_close(fa);
	if (rc != 0) {
		return PROVISIONING_ERR_MAGIC;
	}

	status = provisioning_parse(raw, out);
	if (status != PROVISIONING_OK) {
		return status;
	}

	if (out->role != PROVISIONING_ROLE_DONGLE) {
		memset(out, 0, sizeof(*out));
		return PROVISIONING_ERR_ROLE;
	}

	return PROVISIONING_OK;
}
```

## src/provisioning_flash.h
```c
/*
 * The dongle-side reader for the provisioning record — BUILD_SPEC.md §9.
 * Opens the "storage" flash partition, reads the raw PROVISIONING_RECORD_SIZE
 * bytes, and hands them to the Zephyr-free parser in common/provisioning.c.
 * This file and provisioning_flash.c are the only Zephyr-specific part of
 * provisioning; the record's shape and validity live in common/, shared
 * unchanged with the remote firmware.
 */
#ifndef DONGLE_PROVISIONING_FLASH_H_
#define DONGLE_PROVISIONING_FLASH_H_

#include "provisioning.h"

/*
 * Reads and validates the record, and additionally requires role ==
 * PROVISIONING_ROLE_DONGLE — a record provisioned for a remote and flashed
 * onto a dongle by mistake is exactly the manufacturing error this exists to
 * catch, not a case to let through because the CRC happened to be fine.
 *
 * On any status other than PROVISIONING_OK, *out is untouched. A role that
 * parses but is not DONGLE comes back as PROVISIONING_ERR_ROLE, the same
 * status a genuinely malformed role byte gets — the caller only needs to know
 * "usable or not", and BUILD_SPEC.md §9 sends both to the same ERR line.
 */
enum provisioning_status provisioning_load(struct provisioning_record *out);

#endif /* DONGLE_PROVISIONING_FLASH_H_ */
```

## src/radio.h
```c
/*
 * The engine's entire view of the radio. See dongle/BUILD_SPEC.md §3.
 *
 * Two implementations are selected at build time:
 *
 *   CONFIG_DONGLE_RADIO=n   radio_null.c   nothing connected, downlink on LEDs
 *   CONFIG_DONGLE_RADIO=y   radio_ble.c    BLE central, two remotes
 *
 * radio_null is not scaffolding to be deleted. It is a permanent build
 * configuration in which the whole wire layer runs — exercised by the TEST
 * modes — with no radio anywhere in the system, and it is what makes a radio
 * regression attributable: PLAN.md §5.4 lists eight ways adding a radio
 * degrades a working USB link without touching any USB code, and every one of
 * them is diagnosed by asking "does it still happen with the radio compiled
 * out?" A baseline you can re-run in thirty seconds answers that. A baseline
 * that was green as a milestone six weeks ago does not.
 *
 * The engine never sees a bt_conn, a GATT handle, or a frame. It sees two
 * remotes identified the way the wire protocol identifies them, because the
 * moment the engine knows about connections it acquires a second vocabulary for
 * the same thing and the two drift.
 */
#ifndef DONGLE_RADIO_H_
#define DONGLE_RADIO_H_

#include "protocol.h"
#include "provisioning.h"

#include <stdbool.h>
#include <stdint.h>

/* Opaque here on purpose: radio.h stays free of <zephyr/kernel.h> so the
 * interface reads as a contract rather than as Zephyr plumbing. */
struct k_work_q;

/* The app-owned half of a remote's indicators (PROTOCOL.md §6). LED_PWR and
 * LED_LINK are remote-local and deliberately unreachable from here. */
struct indicator_state {
	uint8_t f1_mode;        /* enum proto_ind_mode */
	uint8_t f1_colour;      /* enum proto_ind_colour */
	uint8_t f2_mode;
	uint8_t f2_colour;
};

/*
 * Every callback is invoked on the workqueue handed to radio_init(), never on
 * the Bluetooth RX thread. That is what preserves the engine's one-producer,
 * no-locking invariant (engine.h) once a second source of events exists.
 */
struct radio_cb {
	/* A press. The engine assigns seq and emits EVT. */
	void (*on_input)(enum proto_remote src, enum proto_button b,
			 enum proto_gesture g);

	/* This remote holds no indicator state — drives JOIN. From UP_READY. */
	void (*on_ready)(enum proto_remote src);

	/* Already debounced per RADIO_PROTOCOL.md §9.4; the engine emits LINK
	 * verbatim. rssi is meaningful only when st is CONNECTED, where
	 * PROTOCOL.md §7 makes it mandatory. */
	void (*on_link)(enum proto_remote src, enum proto_link_state st,
			int8_t rssi);

	/* From UP_TELEMETRY. Feeds the batt field of LINK. */
	void (*on_telemetry)(enum proto_remote src, uint8_t batt_pct,
			     uint8_t flags);

	/*
	 * CTR classification, RADIO_PROTOCOL.md §6.1/§14 A4/A5. The radio
	 * layer owns per-connection CTR bookkeeping (rframe_ctr_accept()) —
	 * these two feed the engine's aggregate radio_gap/radio_dup counters,
	 * which BUILD_SPEC.md §8 already stages for the handshake LOG line.
	 * A duplicate produces no EVT and is not routed through on_input().
	 */
	void (*on_gap)(enum proto_remote src, uint8_t frames_missing);
	void (*on_dup)(enum proto_remote src);

	/* Freeform diagnostic destined for a LOG line. Never semantic. */
	void (*on_diag)(enum proto_remote src, const char *text);

	/*
	 * A13/A14 (RADIO_PROTOCOL.md §3.2, §14): a manufacturing-class fault,
	 * distinct from on_diag() because these are wire-level ERR lines
	 * (proto_enc_err()), not LOG diagnostics — BUILD_SPEC.md §7.1 names the
	 * exact tokens, "SET_MISMATCH" and "REMOTE_PROTO_MISMATCH". The radio
	 * layer has already disconnected by the time this fires.
	 */
	void (*on_fault)(enum proto_remote src, const char *code);

	/*
	 * RADIO_PROTOCOL.md's factory addendum (bench-only, mirrors §16 of
	 * PROTOCOL.md on the other end of this). From RFRAME_UP_FACTORY_STATUS,
	 * itself only ever sent in reply to radio_send_cal_trigger() or
	 * radio_send_otp_burn() below — there is no unsolicited factory status.
	 * `detail` is opaque here (enum drv2605_otp_result on the remote's
	 * side; this layer has no business depending on that header) and is
	 * only meaningful when state is PROTO_FACTORY_OTP_FAILED.
	 */
	void (*on_factory_status)(enum proto_remote src, enum proto_factory_state state,
				  uint8_t detail, bool diag_pass, uint16_t vdd_mv,
				  uint8_t a_cal_comp, uint8_t a_cal_bemf,
				  uint8_t feedback_control);
};

/*
 * `prov` is NULL when the dongle is unprovisioned — engine_start() already
 * logged and reported ERR NO_PROVISIONING before calling this, and
 * RADIO_PROTOCOL.md §14 A19 requires the radio not initiate or advertise at
 * all in that case, so radio_ble.c must treat a NULL prov as "do nothing,
 * return success" rather than as an error to fail radio_init() over. When
 * non-NULL, prov->peer_addr[PROTO_REMOTE_RED]/[PROTO_REMOTE_GREEN] and
 * prov->set_key are the association parameters BUILD_SPEC.md §7.1 needs, and
 * prov->own_addr is the dongle's own LE static random identity address —
 * RP §10.2 requires it fixed at provisioning, which only radio_ble.c can act
 * on, since it is the first Zephyr Bluetooth consumer of the record.
 */
int radio_init(const struct radio_cb *cb, struct k_work_q *workq,
	       const struct provisioning_record *prov);

/*
 * ttl_4ms is the frame's remaining useful life in 4 ms units; 0 means no
 * deadline.
 *
 * A negative return means the frame was not sent at all, and that is a normal
 * outcome rather than an error — BUILD_SPEC §6.3. Exceeding the acknowledgement
 * budget must degrade to silence, never to a late tap: no tap invokes a rule
 * the referee already has ("press again"), while a late tap arriving during the
 * next press is read as acknowledgement of *that* press.
 */
int radio_send_haptic(enum proto_remote r, enum proto_waveform w,
		      uint8_t ttl_4ms);
int radio_send_indicator(enum proto_remote r, const struct indicator_state *s);
int radio_send_config(enum proto_remote r, uint8_t haptic, uint8_t bright);
int radio_send_simsoc(enum proto_remote r, uint8_t pct);

/* RADIO_PROTOCOL.md's factory addendum (bench-only). Negative return means
 * not sent — same "normal outcome, not an error" reasoning as
 * radio_send_haptic() above; engine.c's FACAL/FACOTP handling has nothing
 * further to do about it beyond what happens already (silence: no
 * FACSTATUS reply reaches the bench tool, which is itself the signal that
 * the command did not land). */
int radio_send_cal_trigger(enum proto_remote r);
int radio_send_otp_burn(enum proto_remote r);

/* DN_HOST carries the half of the path the remote cannot see: the USB cable,
 * the browser tab, the laptop's sleep state, the app's own watchdog. */
int radio_send_host(enum proto_remote r, bool up);

/* True once the remote is fully established per RADIO_PROTOCOL.md §9.4 —
 * encrypted, identity validated, CCCD subscribed. Not merely "connected". */
bool radio_is_ready(enum proto_remote r);

/* RP §9.3: "averaged over the last 8 connection events", read by
 * engine.c's link_reemit_handler on its 10 s tick so a re-sent LINK line
 * carries a fresh value rather than whatever was current at the last state
 * transition. 0 for a remote with no sample yet, or under radio_null. */
int8_t radio_rssi(enum proto_remote r);

#endif /* DONGLE_RADIO_H_ */
```

## src/radio_null.c
```c
/*
 * The no-radio implementation. CONFIG_DONGLE_RADIO=n.
 *
 * Both remotes are DISCONNECTED and stay that way; the downlink is rendered on
 * the dongle's two LEDs. Everything above the seam — the parser, the pending
 * table, supervision, the TEST modes, the whole wire layer — runs exactly as it
 * does with a radio, which is the point.
 *
 * THIS REPLACES CONFIG_DONGLE_FAKE_LINK, WHICH WAS DELETED RATHER THAN
 * DEFAULTED OFF. The fake reported both remotes CONNECTED with a fixed RSSI and
 * a fixed battery percentage, so the scoreboard's signal and battery indicators
 * could be exercised before the radio existed. That was reasonable then and is
 * a standing hazard now: it fabricates precisely the values a link test is
 * trying to measure, and it does so plausibly. A Kconfig default is no
 * protection when the failure mode is forgetting to change it — a forgotten `y`
 * produces a passing test. See PLAN.md §4.11 and BUILD_SPEC §3.1.
 *
 * This file tells the truth instead: nothing is connected, because nothing is.
 */
#include "radio.h"
#include "indicator.h"

#include <zephyr/kernel.h>

int radio_init(const struct radio_cb *cb, struct k_work_q *workq,
	       const struct provisioning_record *prov)
{
	/*
	 * Neither is stored, and that is not an oversight.
	 *
	 * radio_null never originates anything: there is no remote to press a
	 * button, come ready, or report telemetry, and link state never changes
	 * from the DISCONNECTED the engine already holds at boot. Keeping a
	 * pointer we would never call would only invite someone to call it.
	 */
	ARG_UNUSED(cb);
	ARG_UNUSED(workq);
	ARG_UNUSED(prov);
	return 0;
}

int radio_send_haptic(enum proto_remote r, enum proto_waveform w,
		      uint8_t ttl_4ms)
{
	/*
	 * The ttl is discarded because there is no transmission to outlive.
	 * Deadline enforcement that matters happens above this seam — the
	 * engine refuses to hand over a tap whose budget is already spent
	 * (BUILD_SPEC §6.3 mechanism 1), and that check is exercised in this
	 * configuration exactly as it is with a radio.
	 */
	ARG_UNUSED(ttl_4ms);

	indicator_haptic(r, w);
	return 0;
}

int radio_send_indicator(enum proto_remote r, const struct indicator_state *s)
{
	/*
	 * Two LEDs cannot render four indicators and their colours. What they
	 * can render honestly is whether this remote is holding *any* app-owned
	 * state, which is enough to tell an idempotent re-assertion from a
	 * change, and that is what STATE is on the bench for.
	 */
	indicator_base(r, s->f1_mode != PROTO_IND_OFF || s->f2_mode != PROTO_IND_OFF);
	return 0;
}

int radio_send_config(enum proto_remote r, uint8_t haptic, uint8_t bright)
{
	/*
	 * Nothing to apply. The board LEDs are driven as GPIO, not PWM, so
	 * there is no brightness to scale and no motor to quieten — and a
	 * stand-in that *appeared* to honour CFG would be the FAKE_LINK mistake
	 * in a different costume. The engine still persists the values and
	 * re-sends them on JOIN, which is the part that has to be right.
	 */
	ARG_UNUSED(r);
	ARG_UNUSED(haptic);
	ARG_UNUSED(bright);
	return 0;
}

int radio_send_simsoc(enum proto_remote r, uint8_t pct)
{
	/*
	 * Nothing to apply, same reasoning as radio_send_config() above:
	 * there is no LED_PWR on this board's two-GPIO indicator stand-in for
	 * a simulated value to drive, and a stand-in that pretended to render
	 * it would be the FAKE_LINK mistake again.
	 */
	ARG_UNUSED(r);
	ARG_UNUSED(pct);
	return 0;
}

int radio_send_cal_trigger(enum proto_remote r)
{
	/* No remote to calibrate. FACAL against radio_null gets silence,
	 * same as any other send in this configuration. */
	ARG_UNUSED(r);
	return -1;
}

int radio_send_otp_burn(enum proto_remote r)
{
	ARG_UNUSED(r);
	return -1;
}

int radio_send_host(enum proto_remote r, bool up)
{
	/*
	 * A15 — instructing both remotes to render link-lost on supervision
	 * expiry — is the one supervision obligation with no executable
	 * reference anywhere, because the emulator models no radio. It cannot
	 * be verified here either; it is verified at Stage 4 by watching
	 * LED_LINK on the DK. Recorded so nobody reads a green no-radio run as
	 * covering it.
	 */
	ARG_UNUSED(r);
	ARG_UNUSED(up);
	return 0;
}

bool radio_is_ready(enum proto_remote r)
{
	ARG_UNUSED(r);
	return false;
}

int8_t radio_rssi(enum proto_remote r)
{
	ARG_UNUSED(r);
	return 0;
}
```

## CMakeLists.txt
```
cmake_minimum_required(VERSION 3.20.0)
find_package(Zephyr REQUIRED HINTS $ENV{ZEPHYR_BASE})
project(remote_dummy)

# Same binding decision as dongle/CMakeLists.txt and remote/CMakeLists.txt,
# same reasoning: identity is baked in at build time by
# dongle/tools/provision.py, no default to fall back to. PLAN.md §4.13.
if(NOT CONFIG_PROVISIONING_HEADER_DIR)
  message(FATAL_ERROR
    "CONFIG_PROVISIONING_HEADER_DIR not set. Generate one with dongle/tools/"
    "provision.py and pass -DCONFIG_PROVISIONING_HEADER_DIR=<dir containing "
    "provisioning_data.h>.")
endif()
if(NOT EXISTS "${CONFIG_PROVISIONING_HEADER_DIR}/provisioning_data.h")
  message(FATAL_ERROR "No provisioning_data.h in ${CONFIG_PROVISIONING_HEADER_DIR}")
endif()
target_include_directories(app PRIVATE ${CONFIG_PROVISIONING_HEADER_DIR})

# ../remote/src/link.c is compiled here UNCHANGED, by source reference, not by
# copy — PLAN.md §4.9: this board's whole reason for existing is to validate
# the *central's* two-connection scheduling with real remote firmware, not a
# thrown-away stand-in that diverges from what M5 extends. link.c has no DK-
# specific code in it at all (no GPIO, no board references) — every board
# dependency it has is through haptic.c/indicators.c's function signatures,
# which this app supplies its own PCA10059-shaped implementations of below.
# Same reasoning as common/ being shared between dongle and remote: one file,
# compiled into two applications, rather than a second copy to keep in step.
target_sources(app PRIVATE
  src/main.c
  src/buttons.c
  src/haptic.c
  src/indicators.c
  ../remote/src/link.c
  ../common/provisioning.c
  ../common/rframe.c
  ../common/ind_colour.c
)

target_include_directories(app PRIVATE ${CMAKE_CURRENT_SOURCE_DIR}/../common)
target_include_directories(app PRIVATE ${CMAKE_CURRENT_SOURCE_DIR}/../dongle/src)

# The headers this app builds against — link.h, buttons.h, haptic.h,
# indicators.h — are all pure interface (no DK-specific content anywhere in
# them, confirmed by reading them before reusing them), so they are reused
# from remote/src/ unchanged rather than duplicated. Only the four .c files
# above are new: main.c/buttons.c/haptic.c/indicators.c implement those same
# declared functions against this board's one button and two-LED hardware
# instead of the DK's seven-button, four-LED layout. link.c's own #include
# "haptic.h" resolves against its own directory (remote/src/) automatically —
# this path exists so THIS app's new .c files, which have no local copies,
# can find the same headers.
target_include_directories(app PRIVATE ${CMAKE_CURRENT_SOURCE_DIR}/../remote/src)
```

## Kconfig
```
menu "Dummy remote options"

config PROVISIONING_HEADER_DIR
	string "Directory containing this unit's generated provisioning_data.h"
	help
	  Same option, same reasoning, as remote/Kconfig and dongle/Kconfig:
	  identity is baked into the image at build time by
	  dongle/tools/provision.py — PLAN.md §4.13. No default.
	  CMakeLists.txt FATAL_ERRORs at configure time if this is empty or
	  the file isn't there.

config REMOTE_TEST_RADIO_PROTO_MAJOR
	int "RR_IDENTITY radio_proto_major to report (bench test only)"
	default 2
	help
	  link.c (reused unchanged from remote/src/) references this symbol
	  directly — remote/Kconfig's own option, duplicated here rather than
	  shared, since Kconfig has no cross-application include mechanism.
	  Same default, same reasoning: A14 has no provisioning-record
	  representation, so this is the one deliberate build-time override,
	  defaulting to the real value (2 as of RADIO_PROTOCOL.md v2.0).

config REMOTE_DUMMY_STIM_INTERVAL_MS
	int "Self-stimulus press interval (ms)"
	default 3000
	help
	  PLAN.md §4.9: this board's job is to hold a connection, consume the
	  downlink, and generate uplink traffic at realistic rates — it does
	  not need a human pressing it. A synthetic press fires on this
	  interval through the identical gesture-classification path a real
	  GPIO edge would use, the same trick dongle/src/engine.c's TEST 2
	  plays for USB-side load. 3 s approximates a plausible referee
	  press cadence; lower it for W6/W7's density and load questions.

endmenu

source "Kconfig.zephyr"
```

## prj.conf
```kconfig
# ---------------------------------------------------------------------------
# Application
# ---------------------------------------------------------------------------
CONFIG_GPIO=y
CONFIG_PWM=y
CONFIG_MAIN_STACK_SIZE=2048
CONFIG_SYSTEM_WORKQUEUE_STACK_SIZE=2048

# ---------------------------------------------------------------------------
# BLE — identical shape to remote/prj.conf: peripheral, GATT server, one
# connection. This board answers the same protocol from the same role
# (RED or GREEN, decided by provisioning, never by firmware) — PLAN.md §4.9's
# whole point is that remote #2 runs real remote firmware, not a simplified
# radio stand-in, so the BLE configuration is not simplified either.
# ---------------------------------------------------------------------------
CONFIG_BT=y
CONFIG_BT_PERIPHERAL=y
CONFIG_BT_SMP=y
CONFIG_BT_NRF_CONN_SET_LTK=y
CONFIG_BT_MAX_CONN=1
CONFIG_BT_MAX_PAIRED=1
CONFIG_BT_BONDABLE=n
CONFIG_BT_PRIVACY=n
CONFIG_BT_SETTINGS=n
CONFIG_BT_DEVICE_NAME="RefRemote"
CONFIG_BT_FILTER_ACCEPT_LIST=y
```

## src/main.c
```c
/*
 * PCA10059 dummy second-remote firmware — PLAN.md §4.9, queue step S8. Real
 * remote firmware (link.c is remote/src/link.c, unmodified, compiled here by
 * source reference), on a board with one button and two LEDs instead of the
 * DK's seven and four: it holds a connection, consumes the downlink, and
 * generates realistic uplink load (buttons.c), so the dongle's two-connection
 * central scheduling has a real second peer to schedule against — not
 * because this board is meant to model a wrist remote, which PLAN.md §4.9
 * explicitly rejects doing.
 */
#include "provisioning_data.h" /* generated by dongle/tools/provision.py; see CMakeLists.txt */
#include "link.h"
#include "buttons.h"
#include "haptic.h"
#include "indicators.h"

#include <zephyr/kernel.h>
#include <zephyr/drivers/gpio.h>

#define REMOTE_STACK_SIZE 2048
#define REMOTE_PRIORITY   K_PRIO_COOP(7)

static struct k_work_q remote_q;
static K_THREAD_STACK_DEFINE(remote_stack, REMOTE_STACK_SIZE);

/*
 * A19: an unprovisioned unit does not advertise, does not initiate, and
 * renders an unmistakable fault — same requirement as remote/src/main.c's
 * fault_forever(), same reasoning (no console, no CDC-ACM instance to spare
 * here either). This board has one LED simple enough to blink unconditionally
 * without touching the RGB/PWM machinery indicators.c and haptic_init() may
 * not have gotten to initialise yet.
 */
static void fault_forever(void)
{
	static const struct gpio_dt_spec led = GPIO_DT_SPEC_GET(DT_ALIAS(led0), gpios);

	if (gpio_is_ready_dt(&led)) {
		(void)gpio_pin_configure_dt(&led, GPIO_OUTPUT_INACTIVE);
	}

	while (1) {
		(void)gpio_pin_set_dt(&led, 1);
		k_sleep(K_MSEC(200));
		(void)gpio_pin_set_dt(&led, 0);
		k_sleep(K_MSEC(200));
	}
}

int main(void)
{
	/* Boot-time sentinel, belt and braces alongside CMakeLists.txt's
	 * build-time refusal to configure without a provisioning_data.h at
	 * all — same reasoning as remote/src/main.c and dongle/src/engine.c. */
	enum provisioning_status st = provisioning_validate(&PROV_RECORD);

	if (st != PROVISIONING_OK ||
	    (PROV_RECORD.role != PROVISIONING_ROLE_RED &&
	     PROV_RECORD.role != PROVISIONING_ROLE_GREEN)) {
		fault_forever();
		return 0; /* unreached */
	}

	k_work_queue_init(&remote_q);
	k_work_queue_start(&remote_q, remote_stack, K_THREAD_STACK_SIZEOF(remote_stack),
			   REMOTE_PRIORITY, NULL);

	if (haptic_init(&remote_q) != 0) {
		fault_forever();
		return 0;
	}
	if (indicators_init(&remote_q) != 0) {
		fault_forever();
		return 0;
	}
	if (link_init(&PROV_RECORD, &remote_q) != 0) {
		fault_forever();
		return 0;
	}
	if (buttons_init(link_on_gesture, &remote_q) != 0) {
		fault_forever();
		return 0;
	}

	return 0;
}
```

## src/buttons.c
```c
#include "buttons.h"

#include <zephyr/kernel.h>
#include <zephyr/drivers/gpio.h>

/*
 * PLAN.md §4.9: this board's job is to prove the *dongle's* central
 * scheduling with a second real connection, not to model a wrist remote —
 * "it does not need seven buttons or a wrist. One button covers all three
 * gestures, and a self-stimulus timer covers sustained load." The one
 * physical button below covers the human-driven case (press it and watch
 * B6 routing on the wire); the self-stimulus timer covers the "GREEN is
 * generating realistic uplink traffic unattended" case W6/W7 actually need.
 * Mapped to ADD_POINT — same as remote/src/buttons.c's button 1 — purely so
 * a physical press is visibly meaningful on the scoreboard during the
 * demonstration, not because the button token means anything on this board.
 *
 * State machine is remote/src/buttons.c's, reduced to one button and no
 * HOLD_REP (remote/BUILD_SPEC.md §4 restricts repeating gestures to
 * FORWARD/BACKWARD, neither of which this board maps).
 */
#define DEBOUNCE_MS       15
#define HOLD_THRESHOLD_MS 600

static const struct gpio_dt_spec button = GPIO_DT_SPEC_GET(DT_ALIAS(sw0), gpios);

enum btn_state {
	BTN_IDLE = 0,
	BTN_DEBOUNCE,
	BTN_DOWN,  /* debounced, waiting for release (PRESS) or threshold (HOLD) */
	BTN_HELD,  /* HOLD already fired; only a release can follow */
};

static enum btn_state state = BTN_IDLE;
static struct gpio_callback gpio_cb;
static struct k_work_delayable timer;
static struct k_work edge_work;
static struct k_work_delayable stim_work;
static buttons_gesture_cb gesture_cb;
static struct k_work_q *buttons_workq;

static bool is_pressed(void)
{
	return gpio_pin_get_dt(&button) > 0;
}

static void emit(enum proto_gesture g)
{
	if (gesture_cb) {
		gesture_cb(PROTO_BTN_ADD_POINT, g);
	}
}

static void timer_handler(struct k_work *work)
{
	ARG_UNUSED(work);

	switch (state) {
	case BTN_DEBOUNCE:
		if (!is_pressed()) {
			state = BTN_IDLE; /* bounced back up inside the window */
			return;
		}
		state = BTN_DOWN;
		k_work_reschedule_for_queue(buttons_workq, &timer,
					    K_MSEC(HOLD_THRESHOLD_MS - DEBOUNCE_MS));
		return;

	case BTN_DOWN:
		/* Threshold reached with the button still down: HOLD fires
		 * once, at the threshold — never on release (§4 detail 1). */
		emit(PROTO_GEST_HOLD);
		state = BTN_HELD;
		return;

	case BTN_IDLE:
	case BTN_HELD:
	default:
		return;
	}
}

static void edge_work_handler(struct k_work *work)
{
	ARG_UNUSED(work);

	bool pressed = is_pressed();

	switch (state) {
	case BTN_IDLE:
		if (pressed) {
			state = BTN_DEBOUNCE;
			k_work_reschedule_for_queue(buttons_workq, &timer, K_MSEC(DEBOUNCE_MS));
		}
		return;

	case BTN_DEBOUNCE:
		return; /* timer_handler's own re-check owns this case */

	case BTN_DOWN:
		if (!pressed) {
			/* Released before the threshold: a genuine PRESS.
			 * This path is only reachable while HOLD has not
			 * fired — once it does, state is BTN_HELD, not
			 * BTN_DOWN (§4 detail 2: a HOLD never also emits a
			 * PRESS). */
			(void)k_work_cancel_delayable(&timer);
			emit(PROTO_GEST_PRESS);
			state = BTN_IDLE;
		}
		return;

	case BTN_HELD:
		if (!pressed) {
			state = BTN_IDLE;
		}
		return;
	}
}

static void gpio_isr(const struct device *port, struct gpio_callback *cb, uint32_t pins)
{
	ARG_UNUSED(port);
	ARG_UNUSED(cb);
	ARG_UNUSED(pins);

	k_work_submit_to_queue(buttons_workq, &edge_work);
}

/*
 * The self-stimulus timer. Fires a synthetic PRESS through the identical
 * gesture_cb() path a real debounced release would use — link_on_gesture()
 * cannot tell the difference, which is the point: this exercises the real
 * CTR-increment and RR_UPLINK-notify code, not a shortcut around it, so the
 * traffic it produces is what W6/W7 actually need to see. Runs on
 * buttons_workq, the same single-producer queue edge_work/timer use, so it
 * never races a real physical press.
 */
static void stim_handler(struct k_work *work)
{
	ARG_UNUSED(work);

	emit(PROTO_GEST_PRESS);
	k_work_reschedule_for_queue(buttons_workq, &stim_work,
				    K_MSEC(CONFIG_REMOTE_DUMMY_STIM_INTERVAL_MS));
}

int buttons_init(buttons_gesture_cb cb, struct k_work_q *workq)
{
	int err;

	gesture_cb = cb;
	buttons_workq = workq;

	if (!gpio_is_ready_dt(&button)) {
		return -ENODEV;
	}
	err = gpio_pin_configure_dt(&button, GPIO_INPUT);
	if (err) {
		return err;
	}
	err = gpio_pin_interrupt_configure_dt(&button, GPIO_INT_EDGE_BOTH);
	if (err) {
		return err;
	}

	k_work_init_delayable(&timer, timer_handler);
	k_work_init(&edge_work, edge_work_handler);
	gpio_init_callback(&gpio_cb, gpio_isr, BIT(button.pin));
	err = gpio_add_callback(button.port, &gpio_cb);
	if (err) {
		return err;
	}

	k_work_init_delayable(&stim_work, stim_handler);
	k_work_reschedule_for_queue(buttons_workq, &stim_work,
				    K_MSEC(CONFIG_REMOTE_DUMMY_STIM_INTERVAL_MS));

	return 0;
}
```

## src/haptic.c
```c
#include "haptic.h"

#include <zephyr/kernel.h>

/*
 * True no-op, deliberately. This board has no ERM and no LED budget left to
 * proxy one: the RGB LED renders DN_INDICATOR colour (indicators.c, the
 * whole reason PLAN.md §4.9 chose this board for bring-up over the spare
 * MDBT50Q-CX-40), and the plain green LED renders LED_LINK. There is no
 * third surface to borrow, unlike the DK's dedicated LED1/pwm_led0.
 *
 * The protocol contract this satisfies is "consume the downlink" (PLAN.md
 * §2.2's S8), not "render it" — a DN_HAPTIC arriving here is accepted,
 * decoded, and discarded, exactly as link.c's own comments already assume
 * (it never inspects what haptic_render()/haptic_set_scale() actually do).
 * Consequence, recorded rather than silently true: the link-lost double
 * buzz indicators.c would otherwise trigger via haptic_render() has nowhere
 * to render on this board either. Real haptic rendering is M5's question
 * (S15/S16), on the DK, which has the LED to spare.
 */
void haptic_render(enum proto_waveform w, uint8_t ttl_4ms)
{
	ARG_UNUSED(w);
	ARG_UNUSED(ttl_4ms);
}

void haptic_set_scale(uint8_t scale)
{
	ARG_UNUSED(scale);
}

int haptic_init(struct k_work_q *workq)
{
	ARG_UNUSED(workq);
	return 0;
}
```

## src/indicators.c
```c
#include "indicators.h"
#include "ind_colour.h"

#include <zephyr/kernel.h>
#include <zephyr/drivers/gpio.h>
#include <zephyr/drivers/pwm.h>

/*
 * This board has exactly two LED positions (confirmed against the installed
 * board devicetree, nrf52840dongle_nrf52840_common.dtsi — not read off alias
 * names alone, CLAUDE.md §6's standing trap): one plain green GPIO LED
 * (led0/led0-green, P0.06) and one RGB LED with all three channels on PWM
 * (pwm-led0/1/2 = red/green/blue, all on pwm0). PLAN.md §4.9 chose this
 * board for bring-up specifically because that RGB LED is "the only surface
 * before M5 that can render DN_INDICATOR colour at all."
 *
 * Only two indicator surfaces exist here, not the DK's four (LED_F1, LED_F2,
 * LED_LINK). LED_F2 is not rendered at all — recorded as a limitation, same
 * spirit as the dongle's own unfitted RED channel (dongle/BOARD.md §2):
 * "no colour" on this board never means "F2 has no state," only that this
 * board cannot show it.
 */
static const struct pwm_dt_spec rgb_r = PWM_DT_SPEC_GET(DT_ALIAS(pwm_led0));
static const struct pwm_dt_spec rgb_g = PWM_DT_SPEC_GET(DT_ALIAS(pwm_led1));
static const struct pwm_dt_spec rgb_b = PWM_DT_SPEC_GET(DT_ALIAS(pwm_led2));
static const struct gpio_dt_spec led_link = GPIO_DT_SPEC_GET(DT_ALIAS(led0), gpios);

static bool radio_up;
static bool host_up;
static enum proto_ind_mode f1_mode_cache;
static enum proto_ind_colour f1_colour_cache;
static uint8_t brightness_pct = 100;

static void rgb_apply(void)
{
	uint8_t rgb[3] = { 0, 0, 0 };
	uint32_t r = 0, g = 0, b = 0;

	if (f1_mode_cache == PROTO_IND_SOLID) {
		ind_colour_rgb(f1_colour_cache, rgb);
		r = ((uint32_t)rgb[0] * brightness_pct) / 100u;
		g = ((uint32_t)rgb[1] * brightness_pct) / 100u;
		b = ((uint32_t)rgb[2] * brightness_pct) / 100u;
	}

	/* 8-bit channel value (0-255) scaled onto each PWM period. */
	(void)pwm_set_pulse_dt(&rgb_r, (uint32_t)(((uint64_t)rgb_r.period * r) / 255u));
	(void)pwm_set_pulse_dt(&rgb_g, (uint32_t)(((uint64_t)rgb_g.period * g) / 255u));
	(void)pwm_set_pulse_dt(&rgb_b, (uint32_t)(((uint64_t)rgb_b.period * b) / 255u));
}

static void update_link(void)
{
	/* Unlike the DK, there is no haptic proxy budget left on this board
	 * for the link-lost double buzz (remote/src/indicators.c's
	 * lost_link_work calls haptic_render(), which is a true no-op here —
	 * see haptic.c). LED_LINK's own on/off conjunction still renders
	 * correctly; only the buzz has nowhere to go. Recorded, not silently
	 * dropped, same discipline as every other unobservable surface in
	 * this project. */
	(void)gpio_pin_set_dt(&led_link, (radio_up && host_up) ? 1 : 0);
}

void indicators_set(enum proto_ind_mode f1_mode, enum proto_ind_colour f1_colour,
		    enum proto_ind_mode f2_mode, enum proto_ind_colour f2_colour)
{
	ARG_UNUSED(f2_mode); /* F2 unrenderable on this board — no LED left */
	ARG_UNUSED(f2_colour);

	f1_mode_cache = f1_mode;
	f1_colour_cache = f1_colour;
	rgb_apply();
}

void indicators_set_brightness(uint8_t led_brightness)
{
	brightness_pct = led_brightness > 100u ? 100u : led_brightness;
	rgb_apply();
}

void indicators_set_radio_up(bool up)
{
	radio_up = up;
	update_link();
}

/* LED_PWR has no surface on this board either — same treatment as F2 above:
 * this board has exactly two LED positions (F1's RGB and LED_LINK's plain
 * green), and DN_SIMSOC's battery ladder has nowhere left to render.
 * Recorded as a limitation, not silently dropped; the ladder itself is
 * confirmed on the DK, which has LED_PWR. */
void indicators_set_battery_pct(uint8_t pct)
{
	ARG_UNUSED(pct);
}

void indicators_set_host_up(bool up)
{
	host_up = up;
	update_link();
}

int indicators_init(struct k_work_q *workq)
{
	ARG_UNUSED(workq); /* nothing timer-driven here, unlike the DK's buzz */

	if (!pwm_is_ready_dt(&rgb_r) || !pwm_is_ready_dt(&rgb_g) || !pwm_is_ready_dt(&rgb_b)) {
		return -ENODEV;
	}
	if (!gpio_is_ready_dt(&led_link)) {
		return -ENODEV;
	}
	if (gpio_pin_configure_dt(&led_link, GPIO_OUTPUT_INACTIVE) != 0) {
		return -EIO;
	}

	f1_mode_cache = PROTO_IND_OFF;
	rgb_apply();

	/* A16: on boot, assume DOWN until told otherwise. Both flags default
	 * false above, so this renders link-lost immediately — the state
	 * that is actually true at this moment. */
	update_link();
	return 0;
}
```
